## Kconfig
```kconfig
menu "Aekeynox extensions"

config AEKEYNOX_CAPS_WORD_STATUS
    bool
    default y
    depends on DT_HAS_AEKEYNOX_BEHAVIOR_CAPS_WORD_STATUS_ENABLED
    depends on !ZMK_SPLIT || ZMK_SPLIT_ROLE_CENTRAL

endmenu
```

## boards/shields/aekeynox_mip/Kconfig.shield
```kconfig
# Copyright (c) 2022 The ZMK Contributors
# SPDX-License-Identifier: MIT

config SHIELD_AEKEYNOX_MIP
    def_bool $(shields_list_contains,aekeynox_mip)
```

## dts/bindings/behaviors/aekeynox,behavior-caps-word-status.yaml
```yaml
# Copyright (c) 2026 Aekeynox contributors
# SPDX-License-Identifier: MIT

description: Caps Word behavior with a state-change event for status displays

compatible: "aekeynox,behavior-caps-word-status"

include: zero_param.yaml

properties:
  continue-list:
    type: array
    required: true
  mods:
    type: int
```
